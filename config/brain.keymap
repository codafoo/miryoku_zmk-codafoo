// Copyright 2023 Manna Harbour
// https://github.com/manna-harbour/miryoku

#include "../miryoku/custom_config.h"
#include "../miryoku/mapping/40/brain.h"
#include "../miryoku/miryoku.dtsi"
#include "../miryoku/custom_combos.dtsi"