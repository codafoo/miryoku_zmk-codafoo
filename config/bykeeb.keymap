// Copyright 2025 Manna Harbour
// https://github.com/manna-harbour/miryoku

// bykeeb uses the minidox mapping (36 keys, 3 thumb keys per side)

#include "../miryoku/custom_config.h"
#include "../miryoku/mapping/36/minidox.h"
#include "../miryoku/miryoku.dtsi"
#include "../miryoku/custom_combos.dtsi"
