// Copyright 2021 Manna Harbour
// https://github.com/manna-harbour/miryoku

// Custom combos shared across all keyboards

/ {
    combos {
        compatible = "zmk,combos";
        combo_tab {
            timeout-ms = <50>;
            key-positions = <23 24>;  // D + Z keys (for Nightingale layout)
            bindings = <&kp TAB>;
            layers = <1>;             // EXTRA layer (Nightingale) only
        };
    };
};
