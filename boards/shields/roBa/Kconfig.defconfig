## boards/shields/roBa/Kconfig.defconfig
```kconfig
if SHIELD_ROBA_RIGHT

config ZMK_KEYBOARD_NAME
    default "roBa"

config ZMK_SPLIT
    default y

config ZMK_SPLIT_ROLE_CENTRAL
    default y

endif

if SHIELD_ROBA_LEFT

config ZMK_KEYBOARD_NAME
    default "roBa"

config ZMK_SPLIT
    default y

endif
```

## boards/shields/roBa/Kconfig.shield
```kconfig
config SHIELD_ROBA_RIGHT
    def_bool $(shields_list_contains,roBa_right)

config SHIELD_ROBA_LEFT
    def_bool $(shields_list_contains,roBa_left)
```
